## conf/layer.conf
```bitbake
# We have a conf and classes directory, add to BBPATH
BBPATH := "${BBPATH}:${LAYERDIR}"

# We have an images and various recipe-* directories, add to BBFILES
BBFILES := "${BBFILES} ${LAYERDIR}/recipes*/*/*.bb*"
	
BBFILE_COLLECTIONS += "cgx-msd-armsr"
BBFILE_PATTERN_cgx-msd-armsr := "^${LAYERDIR}/"
BBFILE_PRIORITY_cgx-msd-armsr = "7"

LAYERSERIES_COMPAT_cgx-msd-armsr = "kirkstone"

LAYERDEPENDS_template = "core "
```
